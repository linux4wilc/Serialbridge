## wilcsbridge/Kconfig
```kconfig
config WILCSBRIDGE
	tristate
	---help---
	This adds support for WILC1000 & WILC3000 chips which support
	of Serial bridge Host Interface to test with MCHPRT tool for Certification and Production test.

config WILC_SDIO_SBRIDGE
	tristate "Microchip WILC SDIO SERIAL BRIDGE"
	select WILCSBRIDGE
	---help---
	  This module adds support for the SDIO interface of adapters using
	  WILC1000 & WILC3000 chipset. The Microchip WILC1000 SDIO is a full speed interface.
	  It meets SDIO card specification version 2.0. The interface supports
	  the 1-bit/4-bit SD transfer mode at the clock range of 0-50 MHz.
	  The host can use this interface to read and write from any register
	  within the chip as well as configure the WILC1000 for data DMA.
	  To use this interface, pin9 (SDIO_SPI_CFG) must be grounded. Select
	  this if your platform is using the SDIO bus.
	  WILC3000 additionally supports BT 4.0 and BLE modes.

config WILC_SPI_SBRIDGE
	tristate "Microchip WILC SPI SERIAL BRIDGE"
	select WILCSBRIDGE
	---help---
	  This module adds support for the SPI interface of adapters using
	  WILC1000 & WILC3000 chipset. The Microchip WILC1000 has a Serial Peripheral
	  Interface (SPI) that operates as a SPI slave. This SPI interface can
	  be used for control and for serial I/O of 802.11 data. The SPI is a
	  full-duplex slave synchronous serial interface that is available
	  immediately following reset when pin 9 (SDIO_SPI_CFG) is tied to
	  VDDIO. Select this if your platform is using the SPI bus.
	  WILC3000 additionally supports BT 4.0 and BLE modes.
```
